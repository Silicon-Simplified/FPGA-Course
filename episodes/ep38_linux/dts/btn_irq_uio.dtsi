/* generated by tools/gen_dts.py from the Vivado address map: do not edit */
&amba_pl {
	btn_irq0: btn-irq@40000000 {
		compatible = "generic-uio";
		reg = <0x40000000 0x1000>;
		interrupt-parent = <&intc>;
		interrupts = <0 29 4>;   /* SPI 29 = GIC ID 61, level high */
	};
};
